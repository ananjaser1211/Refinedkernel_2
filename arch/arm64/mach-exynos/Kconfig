## arch/arm64/mach-exynos/Kconfig
```kconfig
# arch/arm64/mach-exynos/Kconfig
#
# Copyright (c) 2016 Samsung Electronics Co., Ltd.
#		http://www.samsung.com/
#
# Licensed under GPLv2

# Configuration options for the EXYNOS7

if ARCH_EXYNOS

menu "SAMSUNG EXYNOS SoCs Support"

config SKIP_HW_BREAKPOINT
	bool "support skip hw breakpoint"
	default n
	help
	  Support early param for T32 onchip breakpoint

config SEC_BAT_AUT
	bool "Samsung TN Bat Automation Test Feature"
	default n
	help
	  Samsung TN Bat Automation Test

config SAMSUNG_PRODUCT_SHIP
	bool "set up for product shipping"
	default n	  
endmenu

endif

config THUNDERPLUG_CONTROL
	bool "Enable plugging down/up of cores based on load per core"
	depends on SMP && HOTPLUG_CPU
	default n
	help
	  This driver hotplugs cpu cores based on per-core load
```

## drivers/ccic/Kconfig
```kconfig
#
# USB PD driver
#

comment "USB PD configs"

config USE_CCIC
	bool "Using USBPD device driver"
	depends on I2C
	default n
	help
	  If you say yes here you will get support for
	  the USB PD(Power Delivery) device driver.

config CCIC_S2MU004
	bool "Using S2MU004 USB PD"
	depends on USE_CCIC
	default n
	help
	  If you say yes here you will get support for
	  for the S2MU004 USBPD chip.

config CCIC_S2MM005 
	bool "CCIC S2MM005"
	depends on I2C 
	default n
	help
	  If you say yes here you will get support for
	  s2mm005 ccic full version chipset 
	  
config CCIC_NOTIFIER
	bool "CCIC notifier support"
	depends on I2C
	default n
	help
	  If you say yes here you will get support for
	  the CCIC attached device status change notification.
```
